VERSION ""

NS_ :

BS_:

BU_: XXX

BO_ 8 NEW_MSG_1: 8 XXX
 SG_ NEW_SIGNAL_1 : 31|16@0+ (1,0) [0|65535] "" XXX

BO_ 437 NEW_MSG_2: 8 XXX
 SG_ WHEEL_ANGLE_RIGHT : 47|16@0+ (1,0) [0|65535] "" XXX
 SG_ WHEEL_ANGLE_L : 31|16@0+ (1,0) [0|65535] "" XXX
